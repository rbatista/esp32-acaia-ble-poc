## sdkconfig.defaults
```kconfig
# Arduino framework configuration
CONFIG_ARDUINO_LOOP_STACK_SIZE=8192
CONFIG_ARDUINO_EVENT_RUNNING_CORE=1

# FreeRTOS configuration required by Arduino
CONFIG_FREERTOS_HZ=1000

# BLE configuration
CONFIG_BT_ENABLED=y
CONFIG_BT_NIMBLE_ENABLED=y
CONFIG_BT_NIMBLE_ROLE_PERIPHERAL=y
CONFIG_BT_NIMBLE_ROLE_CENTRAL=y
CONFIG_BT_NIMBLE_ROLE_BROADCASTER=y
CONFIG_BT_NIMBLE_ROLE_OBSERVER=y

# Serial configuration
CONFIG_ESP_CONSOLE_UART_DEFAULT=y
```
